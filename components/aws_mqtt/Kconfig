## components/aws_mqtt/Kconfig
```kconfig
menu "AWS MQTT configuration"

config AWS_IOT_ENDPOINT
    string "AWS IoT Core endpoint"
    default "example-ats.iot.region.amazonaws.com"

config AWS_CLIENT_ID
    string "MQTT client id"
    default "esp_grow_controller"

config AWS_ROOT_CA_PATH
    string "Root CA path or partition label"
    default "" 

config AWS_DEVICE_CERT_PATH
    string "Device cert path or partition label"
    default "" 

config AWS_DEVICE_KEY_PATH
    string "Device private key path or partition label"
    default "" 

endmenu
```

## components/ble/Kconfig
```kconfig
menu "BLE component configuration"

config BLE_DEVICE_NAME
    string "HortusBLE"
    default "esp_grow_controller"

config BLE_PROV_USE_ESP_PROV
    bool "Use ESP BLE Provisioning (compatible with Espressif app)"
    default y

config BLE_PROV_SERVICE_NAME
    string "Provisioning service name (SSID for BLE provisioning)"
    depends on BLE_PROV_USE_ESP_PROV
    default "PROV_C3"

config BLE_PROV_POP
    string "Proof-of-Possession (PoP)"
    depends on BLE_PROV_USE_ESP_PROV
    default "abcd1234"

config BLE_PROV_SERVICE_UUID
    string "Provisioning service UUID"
    default "12345678-1234-5678-1234-56789abcdef0"

endmenu

menu "BLE testing"

config BLE_TESTING
    bool "Enable BLE testing hooks"
    default n

endmenu
```

## components/control/Kconfig
```kconfig
menu "Control component configuration"

config CONTROL_LIGHT_GPIO
    int "LED PWM GPIO (Light)"
    default 18

config CONTROL_PUMP_GPIO
    int "LED PWM GPIO (Pump)"
    default 19

config CONTROL_LEDC_TIMER
    int "LEDC timer (0..3)"
    default 0

config CONTROL_LEDC_FREQ
    int "LEDC frequency (Hz)"
    default 5000

config CONTROL_DEFAULT_RAMP_MS
    int "Default soft-ramp (ms)"
    default 1000

endmenu
```

## components/net/Kconfig
```kconfig
menu "Network component configuration"

config NET_SSID_MAX_LEN
    int "Max SSID length"
    default 32

config NET_PSK_MAX_LEN
    int "Max PSK length"
    default 64

config NET_WIFI_MAX_RETRY
    int "Max Wi-Fi reconnect retries"
    default 10
    help
        Number of consecutive reconnect attempts before declaring failure.

config NET_BLE_FALLBACK_SEC
    int "BLE fallback activation threshold (seconds without Wi-Fi)"
    default 60
    help
        If Wi-Fi is down for this many seconds, enable BLE provisioning.

config NET_WIFI_STABLE_MIN
    int "Disable BLE after Wi-Fi stable for (minutes)"
    default 5
    help
        After Wi-Fi has been up for this many minutes, disable BLE to reduce attack surface.

endmenu
```

## components/ota/Kconfig
```kconfig
menu "OTA component configuration"

config OTA_MAX_RETRIES
    int "Max OTA retries before rollback"
    default 3

endmenu
```

## components/safety/Kconfig
```kconfig
menu "Safety component configuration"

config SAFETY_WDT_TIMEOUT_S
    int "Task watchdog timeout (seconds)"
    default 5

config SAFETY_TASK_INTERVAL_MS
    int "Safety task check interval (ms)"
    default 1000
    help
        How often the high-priority safety task runs its monitoring checks.
        This must be less than the WDT timeout.

endmenu
```

## components/schedule/Kconfig
```kconfig
menu "Schedule component configuration"

config SCHEDULE_DEFAULT_ON_HOUR
    int "Default ON hour (local time)"
    default 7

config SCHEDULE_DEFAULT_OFF_HOUR
    int "Default OFF hour (local time)"
    default 21

config SCHEDULE_LIGHT_ON_PCT
    int "Light duty when ON (%)"
    default 70
    range 0 100
    help
        When the current time is within the ON window, the light will be set to this duty cycle.

config SCHEDULE_PUMP_ON_PCT
    int "Pump duty when ON (%)"
    default 70
    range 0 100
    help
        When the pump cycle is ON, the pump will be set to this duty cycle.

config SCHEDULE_PUMP_ON_DURATION_MIN
    int "Pump ON duration (minutes)"
    default 5
    range 1 1440
    help
        Number of minutes to keep the pump ON each cycle after time sync.

config SCHEDULE_PUMP_ON_INTERVAL_MIN
    int "Pump ON interval (minutes)"
    default 30
    range 1 1440
    help
        Period between the start of successive pump ON cycles. Must be >= duration.

config SCHEDULE_DEFAULT_TZ
    string "Default IANA Timezone"
    default "UTC"
    help
        Default timezone to use until one is provisioned.
        See https://en.wikipedia.org/wiki/List_of_tz_database_time_zones

endmenu
```

## components/storage/Kconfig
```kconfig
menu "Storage component configuration"

config STORAGE_NAMESPACE
    string "NVS namespace for configs"
    default "app_config"

config STORAGE_MAX_BLOB
    int "Maximum config blob size (bytes)"
    default 1024

endmenu
```

## components/telemetry/Kconfig
```kconfig
menu "Telemetry component configuration"

    config TELEMETRY_HEARTBEAT_INTERVAL_S
        int "Heartbeat interval (seconds)"
        default 300
        help
            The interval at which the device sends a heartbeat message.

    config TELEMETRY_HEARTBEAT_TOPIC
        string "MQTT topic for heartbeats"
        default "device/heartbeat"
        help
            The MQTT topic to which heartbeat messages are published.

    config TELEMETRY_AUDIT_TOPIC
        string "MQTT topic for audit logs"
        default "device/audit"
        help
            The MQTT topic to which audit log messages are published.

endmenu
```

## sdkconfig.defaults
```kconfig
# Default sdkconfig for esp32-c3 target
CONFIG_IDF_TARGET="esp32c3"
# Use custom partition table provided in the repo
CONFIG_PARTITION_TABLE_CUSTOM=y
CONFIG_PARTITION_TABLE_CUSTOM_FILENAME="partitions.csv"
CONFIG_ESPTOOLPY_FLASHSIZE_4MB=y
CONFIG_ESPTOOLPY_FLASHSIZE="4MB"
# Console output: use USB Serial/JTAG as the primary console for stable CDC on Windows.
# This keeps bootloader and app using the same USB interface so the COM port re-appears
# on the same device after resets. If you prefer a physical UART adapter, comment these
# and re-enable the UART defaults below instead.
CONFIG_ESP_CONSOLE_USB_SERIAL_JTAG=y
# Disable the default UART console (we still keep its baud in case it is re-enabled).
# CONFIG_ESP_CONSOLE_UART_DEFAULT is not set
CONFIG_ESP_CONSOLE_SECONDARY_NONE=y
CONFIG_ESP_CONSOLE_UART_NUM=0
CONFIG_ESP_CONSOLE_UART_BAUDRATE=115200
# FreeRTOS config
# Use single core for C3 to reduce complexity
CONFIG_FREERTOS_UNICORE=y

# Security hints (do not enable fuse-related options here; fusing is manual)
# These are set to OFF by default; document enabling in README for production.
# CONFIG_SECURE_BOOT=y
# CONFIG_FLASH_ENCRYPTION_ENABLED=y

# Brown-out detector
CONFIG_ESP32_BROWNOUT_DET=y
CONFIG_ESP32_BROWNOUT_DET_LVL=7

# USB Serial/JTAG driver
CONFIG_USJ_ENABLE_USB_SERIAL_JTAG=y

# Enable Bluetooth (NimBLE) on ESP32-C3 for commissioning
CONFIG_BT_ENABLED=y
CONFIG_BT_NIMBLE_ENABLED=y
CONFIG_BT_NIMBLE_ROLE_BROADCASTER=y
CONFIG_BT_NIMBLE_ROLE_PERIPHERAL=y
CONFIG_BT_NIMBLE_NVS_PERSIST=y
CONFIG_BT_NIMBLE_MAX_CONNECTIONS=1
CONFIG_BT_NIMBLE_SVC_GAP_DEVICE_NAME="ESP-C3-PROV"
```
